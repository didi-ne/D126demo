## packages/artinchip/ble-img/Kconfig
```kconfig
config AIC_BLE_IMG_PUSH
    bool "BLE image push GATT server (FF00)"
    default n
    depends on LPKG_USING_ZEPHYR_BLUETOOTH
    depends on AIC_WIRELESS_LAN
    select AIC_USING_UART3
    select LPKG_BT_PERIPHERAL
    select CONFIG_AIC8800_BT_SUPPORT
    help
        D126 BLE image push. Advertises AYYDDFQ, GATT service FF00
        (CTRL FF01 / DATA FF02 / STATUS FF03). HCI uses on-chip UART3.
```

## target/configs/d12p_d126-demo124-nand_baremetal_bootloader_defconfig
```kconfig
CONFIG_PRJ_DEFCONFIG_FILENAME="d12p_d126-demo124-nand_baremetal_bootloader_defconfig"
CONFIG_PRJ_CHIP="d12p"
CONFIG_PRJ_BOARD="d126-demo124-nand"
CONFIG_PRJ_KERNEL="baremetal"
CONFIG_PRJ_APP="bootloader"
CONFIG_PRJ_CUSTOM_LDS="application/baremetal/bootloader/ldscript/d12p_bootloader_gcc.ld"
CONFIG_AIC_USING_UART0=y
CONFIG_AIC_USING_QSPI0=y
CONFIG_AIC_QSPI0_DEVICE_SPINAND=y
# CONFIG_AIC_USING_SDMC0 is not set
# CONFIG_AIC_USING_SDMC1 is not set
# CONFIG_AIC_USING_GE is not set
# CONFIG_AIC_USING_VE is not set
CONFIG_AIC_USING_WRI=y
CONFIG_AIC_USING_RTC=y
CONFIG_AIC_USING_WDT=y
CONFIG_AIC_PSRAM_SW_SIZE=0x300000
CONFIG_AIC_INTERRUPTSTACK_SIZE=8192
CONFIG_AIC_USING_SID=y
CONFIG_EFUSE_WRITE_SUPPORT=y
CONFIG_AIC_SYSCFG_LDO1X_ENABLE=y
CONFIG_AIC_NORMALSTACK_SIZE=8192
CONFIG_AIC_BOOTLOADER_TEXT_SIZE=0x7FF00
# CONFIG_AIC_BOOTLOADER_SPINOR_SUPPORT is not set
CONFIG_AIC_BOOTLOADER_AXICFG_SUPPORT=y
CONFIG_AIC_AXICFG_PORT_DVP_EN=y
CONFIG_AIC_AXICFG_PORT_DVP_PRIO=10
CONFIG_AICUPG_NAND_ARTINCHIP=y
CONFIG_AICUPG_NAND_SPL_PT_VER_20=y
# CONFIG_AICUPG_LOG_BUFFER_SUPPORT is not set
CONFIG_AIC_BOOTLOADER_CMD_NAND_BOOT=y
CONFIG_AIC_BOOTLOADER_CMD_MTD=y
CONFIG_LPKG_CHERRYUSB_DEVICE_CLASS_AIC_SINGLE=y
# CONFIG_LPKG_MPP is not set
CONFIG_AIC_LOG_LEVEL_INFO=y
CONFIG_SPI_NAND_DOSILICON=y
CONFIG_SPI_NAND_ETRON=y
CONFIG_SPI_NAND_MICRON=y
CONFIG_SPI_NAND_MACRONIX=y
CONFIG_SPI_NAND_WINBOND=y
CONFIG_SPI_NAND_GIGADEVICE=y
CONFIG_SPI_NAND_TOSHIBA=y
CONFIG_SPI_NAND_FORESEE=y
CONFIG_SPI_NAND_XTX=y
CONFIG_SPI_NAND_ZETTA=y
CONFIG_SPI_NAND_ZBIT=y
CONFIG_SPI_NAND_ESMT=y
CONFIG_SPI_NAND_UMTEK=y
CONFIG_SPI_NAND_QUANXING=y
CONFIG_AIC_NFTL_SUPPORT=y
```
